#include "ili9225.h"
#include "esp_log.h"
#include "freertos/FreeRTOS.h"
#include "freertos/task.h"
#include "string.h"

static const char *TAG = "ILI9225";

static spi_device_handle_t spi;
static gpio_num_t dc_pin;

static void ili_cmd(uint16_t cmd)
{
    spi_transaction_t t = {0};

    gpio_set_level(dc_pin, 0);

    uint8_t data[2];
    data[0] = cmd >> 8;
    data[1] = cmd & 0xFF;

    t.length = 16;
    t.tx_buffer = data;

    spi_device_transmit(spi, &t);
}

static void ili_data(uint16_t data16)
{
    spi_transaction_t t = {0};

    gpio_set_level(dc_pin, 1);

    uint8_t data[2];
    data[0] = data16 >> 8;
    data[1] = data16 & 0xFF;

    t.length = 16;
    t.tx_buffer = data;

    spi_device_transmit(spi, &t);
}

static void ili_write_reg(uint16_t reg, uint16_t data)
{
    ili_cmd(reg);
    ili_data(data);
}

esp_err_t ili9225_init(const ili9225_config_t *cfg)
{
    spi_bus_config_t buscfg = {
        .mosi_io_num = cfg->mosi,
        .miso_io_num = -1,
        .sclk_io_num = cfg->sclk,
        .quadwp_io_num = -1,
        .quadhd_io_num = -1
    };

    spi_bus_initialize(cfg->spi_host, &buscfg, SPI_DMA_CH_AUTO);

    spi_device_interface_config_t devcfg = {
        .clock_speed_hz = cfg->clock_speed_hz,
        .mode = 0,
        .spics_io_num = cfg->cs,
        .queue_size = 1
    };

    spi_bus_add_device(cfg->spi_host, &devcfg, &spi);

    dc_pin = cfg->dc;

    gpio_set_direction(cfg->dc, GPIO_MODE_OUTPUT);
    gpio_set_direction(cfg->rst, GPIO_MODE_OUTPUT);

    gpio_set_level(cfg->rst, 0);
    vTaskDelay(pdMS_TO_TICKS(50));
    gpio_set_level(cfg->rst, 1);
    vTaskDelay(pdMS_TO_TICKS(50));

    ili_write_reg(0x01, 0x011C);
    ili_write_reg(0x02, 0x0100);
    ili_write_reg(0x03, 0x1030);
    ili_write_reg(0x08, 0x0808);
    ili_write_reg(0x0F, 0x0D01);

    ESP_LOGI(TAG, "ILI9225 initialized");

    return ESP_OK;
}

void ili9225_draw_pixel(uint16_t x, uint16_t y, uint16_t color)
{
    ili_write_reg(0x20, x);
    ili_write_reg(0x21, y);

    ili_cmd(0x22);
    ili_data(color);
}

void ili9225_fill_screen(uint16_t color)
{
    uint32_t pixels = ILI9225_WIDTH * ILI9225_HEIGHT;

    ili_write_reg(0x20, 0);
    ili_write_reg(0x21, 0);

    ili_cmd(0x22);

    for (uint32_t i = 0; i < pixels; i++)
    {
        ili_data(color);
    }
}

void ili9225_draw_rect(uint16_t x, uint16_t y,
                       uint16_t w, uint16_t h,
                       uint16_t color)
{
    for (int i = 0; i < w; i++)
    {
        for (int j = 0; j < h; j++)
        {
            ili9225_draw_pixel(x + i, y + j, color);
        }
    }
}

static const uint8_t font5x7[][5] = {
    {0x00,0x00,0x00,0x00,0x00}, // space
    {0x00,0x00,0x5F,0x00,0x00}, // !
    {0x00,0x07,0x00,0x07,0x00}, // "
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    {0x61,0x51,0x49,0x45,0x43}, // Z
};

void ili9225_draw_char(uint16_t x, uint16_t y, char c, uint16_t color, uint16_t bg)
{
    if (c < 32 || c > 90) c = ' ';

    const uint8_t *bitmap = font5x7[c - 32];

    for (int col = 0; col < 5; col++) {
        uint8_t line = bitmap[col];
        for (int row = 0; row < 8; row++) {
            if (line & (1 << row)) {
                ili9225_draw_pixel(x + col, y + row, color);
            } else {
                ili9225_draw_pixel(x + col, y + row, bg);
            }
        }
    }

    for (int row = 0; row < 8; row++) {
        ili9225_draw_pixel(x + 5, y + row, bg);
    }
}

void ili9225_draw_string(uint16_t x, uint16_t y, const char *str, uint16_t color, uint16_t bg)
{
    while (*str) {
        ili9225_draw_char(x, y, *str, color, bg);
        x += 6;
        str++;
    }
}